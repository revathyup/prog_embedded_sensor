## part1/build/Kconfig/arch/Kconfig
```kconfig
# Load Zephyr Arch Kconfig descriptions.
osource "C:/Users/upill/zephyrproject/zephyr/arch/x86/Kconfig"
osource "C:/Users/upill/zephyrproject/zephyr/arch/xtensa/Kconfig"
osource "C:/Users/upill/zephyrproject/zephyr/arch/sparc/Kconfig"
osource "C:/Users/upill/zephyrproject/zephyr/arch/riscv/Kconfig"
osource "C:/Users/upill/zephyrproject/zephyr/arch/posix/Kconfig"
osource "C:/Users/upill/zephyrproject/zephyr/arch/nios2/Kconfig"
osource "C:/Users/upill/zephyrproject/zephyr/arch/mips/Kconfig"
osource "C:/Users/upill/zephyrproject/zephyr/arch/arm64/Kconfig"
osource "C:/Users/upill/zephyrproject/zephyr/arch/arm/Kconfig"
osource "C:/Users/upill/zephyrproject/zephyr/arch/arc/Kconfig"
```

## part1/build/Kconfig/boards/Kconfig.defconfig
```kconfig
# Load Zephyr board defconfig descriptions.
osource "C:/Users/upill/zephyrproject/zephyr/boards/raspberrypi/rpi_pico/Kconfig.defconfig"
```

## part1/build/Kconfig/boards/Kconfig.sysbuild
```kconfig
# Load Sysbuild board Kconfig descriptions.
osource "C:/Users/upill/zephyrproject/zephyr/boards/raspberrypi/rpi_pico/Kconfig.sysbuild"
```

## part2/build/Kconfig/boards/Kconfig
```kconfig
# Load Zephyr board Kconfig descriptions.
osource "C:/Users/upill/zephyrproject/zephyr/boards/raspberrypi/rpi_pico/Kconfig"
```

## part2/build/Kconfig/boards/Kconfig.rpi_pico
```kconfig
# Load board Kconfig descriptions.
osource "C:/Users/upill/zephyrproject/zephyr/boards/raspberrypi/rpi_pico/Kconfig.rpi_pico"
```
